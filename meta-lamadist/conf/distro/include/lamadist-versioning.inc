## meta-lamadist/conf/distro/include/lamadist-versioning.inc
```bitbake
# vi:ft=bitbake
# SPDX-License-Identifier: Apache-2.0
#
# LamaDist version computation.
#
# DISTRO_VERSION_BASE is the human-readable release number.
# DISTRO_VERSION appends the git metadata revision for
# traceability.  The vardepvalue pin ensures sstate hashes
# depend only on the base version, not the ever-changing
# METADATA_REVISION, so the sstate cache remains valid
# across commits within the same release series.

DISTRO_VERSION_BASE = '0.1'
DISTRO_VERSION ?= "${DISTRO_VERSION_BASE}+snapshot-${METADATA_REVISION}"
DISTRO_VERSION[vardepvalue] ?= "${DISTRO_VERSION_BASE}"
DISTRO_CODENAME = 'main'
```

## meta-lamadist/conf/distro/lamadist.conf
```bitbake
# vi:ft=bitbake
# SPDX-License-Identifier: Apache-2.0
#
# LamaDist — embedded Linux distribution by LamaGrid.
#
# This file is the entry point for the distro configuration.
# All policy is defined in the include files below.

DISTRO = 'lamadist'
DISTRO_NAME = 'LamaDist'

require conf/distro/include/lamadist-versioning.inc
require conf/distro/include/lamadist-base.inc
require conf/distro/include/lamadist-security.inc
```

## meta-lamadist/conf/layer.conf
```bitbake
# SPDX-License-Identifier: Apache-2.0

BBPATH =. "${LAYERDIR}:"
BBFILES += "${LAYERDIR}/recipes-*/*/*.bb \
            ${LAYERDIR}/recipes-*/*/*.bbappend"

BBFILE_COLLECTIONS += 'lamadist'
BBFILE_PATTERN_lamadist = "^${LAYERDIR}/"
BBFILE_PRIORITY_lamadist = '50'

# This should only be incremented on significant changes that will
# cause compatibility issues with other layers
LAYERVERSION_lamadist = '1'

LAYERSERIES_COMPAT_lamadist = 'scarthgap'
LAYERDEPENDS_lamadist = 'core security selinux secure-core signing-key integrity-layer encrypted-storage'

# This is used by the tegra-distro-sanity bbclass
# to identify the distro layer directory during
# bblayers checks.
#TD_DISTRO_LAYERDIR = "${LAYERDIR}"
```
